## drivers/vibrator/Kconfig
```kconfig
source "drivers/vibrator/common/Kconfig"

source "drivers/vibrator/dc/Kconfig"

source "drivers/vibrator/imagis/Kconfig"

source "drivers/vibrator/max77705_haptic/Kconfig"

source "drivers/vibrator/sec_haptic/Kconfig"
```

## drivers/vibrator/sec_haptic/Kconfig
```kconfig
config SEC_HAPTIC
	tristate "sec haptic"
	default n
	depends on SEC_SYSFS
	help
	  If you say yes here you will get support for the
	  sec haptic driver.
	  To enable this driver, SEC_SYSFS should be enabled and
	  motor driver calls this driver.
```
